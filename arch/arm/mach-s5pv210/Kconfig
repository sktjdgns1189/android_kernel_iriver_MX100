## arch/arm/mach-s5pv210/Kconfig
```kconfig
# arch/arm/mach-s5pv210/Kconfig
#
# Copyright (c) 2010 Samsung Electronics Co., Ltd.
#		http://www.samsung.com/
#
# Licensed under GPLv2

# Configuration options for the S5PV210/S5PC110

if ARCH_S5PV210

config CPU_S5PV210
	bool
	select PLAT_S5P
	select S5PV210_PM if PM
	help
	  Enable S5PV210 CPU support

choice
	prompt "Select machine type"
	depends on ARCH_S5PV210
	default MACH_SMDKV210

config MACH_SMDKV210
	bool "SMDKV210"
	select CPU_S5PV210
	select ARCH_SPARSEMEM_ENABLE
	select S3C_DEV_HSMMC
	select S3C_DEV_HSMMC1 if !S5PV210_SD_CH0_8BIT
	select S3C_DEV_HSMMC2
	select S3C_DEV_HSMMC3 if !S5PV210_SD_CH2_8BIT
	select S5PV210_SETUP_SDHCI
	select PCI
	help
	  Machine support for Samsung SMDKV210

config MACH_SMDKC110
	bool "SMDKC110"
	select CPU_S5PV210
	select DISCONTIGMEM
	select S3C_DEV_HSMMC
	select S3C_DEV_HSMMC1 if !S5PV210_SD_CH0_8BIT
	select S3C_DEV_HSMMC2
	select S3C_DEV_HSMMC3 if !S5PV210_SD_CH2_8BIT
	select S5PV210_SETUP_SDHCI
	select ARCH_DISCONTIGMEM_ENABLE
	select PCI
	help
	  Machine support for Samsung SMDKC110
	  S5PC110(MCP) is one of package option of S5PV210

endchoice

choice
	prompt "Select DMC0 memory type for S5PC110"
	depends on MACH_SMDKC110
	default S5PC110_MEM_DMC0_ONEDRAM

config S5PC110_MEM_DMC0_ONEDRAM
	bool "OneDRAM"
	help
	  If you have S5PC110 B-Type or D-Type, select it

config S5PC110_MEM_DMC0_MDDR
	bool "mDDR"
	help
	  if you have S5PC110 H-Type or N-Type, select it

endchoice

choice
	prompt "CPU revision"
	depends on CPU_S5PV210
	default CPU_S5PV210_EVT1

config CPU_S5PV210_EVT0
	bool "EVT0"
	help
	  Support EVT0

config CPU_S5PV210_EVT1
	bool "EVT1"
	help
	  Support EVT1
endchoice

### iriver config start, ktj ###
	comment "iriver MX100 settings"
	depends on MACH_SMDKC110	

config MX100
	bool "Select MX100 iriver android tablet"
	depends on MACH_SMDKC110
	default y
	help
		Set config iriver MX100 android tablet.

choice
    prompt "Setup H/W Board for MX100"
    depends on MX100
	default MX100_EVM1

config MX100_EVM
    bool "select board EVM"
    depends on MX100
    help
	  Select board EVM of MX100

config MX100_WS
    bool "select board WS"
    depends on MX100
    help
	  Select board EVM of WS

endchoice

config MX100_REV_ES
	bool "MX100 Revisioen E/S event"
	depends on MX100
	default n
	help
	  MX100 Revision T/P event

config MX100_REV_TP
	bool "MX100 Revisioen T/P event"
	depends on MX100
	default n
	help
	  MX100 Revision T/P event

config MX100_PROC_FW
	bool "MX100 Process Firmware"
	depends on MX100
	default n
	help
	  MX100 Firmware For Process
### iriver config end ###

config SERIAL_USE_HIGH_CLOCK
	bool "SamSung Serail clock Config"
	depends on MX100
	default n
	help
	  Use 133.4Mhz clock for all uarts.

config DM9000_16BIT
	bool "DM9000 16-bit"
	depends on MACH_SMDKV210 || MACH_VOGUEV210 || MACH_SMDKC110
	default n
	help
	  Support DM9000 ethernet controller with 16bit data bus

config S5PV210_PM
	bool
	help
	  Power Management code common to S5PV210

config S5PV210_SETUP_FB_S3C
	bool
	default y
	help
	  Setup code for S5PV210 FIMD

config S5PV210_SETUP_FIMC0
	bool
	default y
	help
	  Common setup code for FIMC controller 0.

config S5PV210_SETUP_FIMC1
	bool
	default y
	help
	  Common setup code for FIMC controller 1.

config S5PV210_SETUP_FIMC2
	bool
	default y
	help
	  Common setup code for FIMC controller 2.

config S5PV210_SETUP_CSIS
	bool
	default y
	help
	  Common setup code for MIPI-CSIS


config S5PV210_SETUP_SDHCI
	bool
	depends on PLAT_S5P
	default y
	help
	  Internal helper functions for S5PCV210 based SDHCI systems

comment "MMC/SD slot setup"
depends on PLAT_S5P

menu "Use 8-bit bus width"
config S5PV210_SD_CH0_8BIT
bool "Channel 0"
depends on PLAT_S5P
default n
help
IF channel 0 uses 8-bit bus, channel 1 is disabled.

config S5PV210_SD_CH2_8BIT
bool "Channel 2"
depends on PLAT_S5P
default n
help
IF channel 2 uses 8-bit bus, channel 3 is disabled.
endmenu

menu "Use dynamic clock gating"
config MMC_CH0_CLOCK_GATING
	bool "Channel 0"
	depends on S3C_DEV_HSMMC
	default n
	help
		This feature turns off clock of channel 0
		for power saving when MMC/SD cards are not used.
config MMC_CH1_CLOCK_GATING
	bool "Channel 1"
	depends on S3C_DEV_HSMMC1
	default n
	help
		This feature turns off clock of channel 1
		for power saving when MMC/SD cards are not used.
config MMC_CH2_CLOCK_GATING
	bool "Channel 2"
	depends on S3C_DEV_HSMMC2
	default n
	help
		This feature turns off clock of channel 2
		for power saving when MMC/SD cards are not used.
config MMC_CH3_CLOCK_GATING
	bool "Channel 3"
	depends on S3C_DEV_HSMMC3
	default n
	help
		This feature turns off clock of channel 3
		for power saving when MMC/SD cards are not used.
endmenu

# platform specific device setup
# ADC part
config S5PV210_ADC
        bool "S5PV210_ ADC Driver"
        depends on CPU_S5PV210
        help
          ADC (A/D Conversion) driver for Samsung S5PV210.

config MX100_IOCTL
        bool "MX100 IOCTL Driver"
        depends on CPU_S5PV210
        help
        peri IOCTL driver for mx100.
# JHLIM
config MX100_JACK
	bool "MX100 JACK Detector Driver"
	depends on CPU_S5PV210
	help
	mx100 headset jack detector driver.

endif
```

## drivers/net/wireless/bcm4329/Kconfig
```kconfig
config BCM4329
	tristate "Broadcom BCM4329 wireless chip support"
	depends on WIRELESS_EXT && MMC
	---help---
	  This module adds support for wireless adapters based on
	  Broadcom 4329 chipset.

	  This driver uses the kernel's wireless extensions subsystem.

config BCM4329_WL_RESET_GPIO
	depends on BCM4329
	int "BCM4329 WLAN Reset GPIO number"
	default 20

config BCM4329_FW_PATH
	depends on BCM4329
	string "Firmware path"
	default "/etc/wl/bcm4329.bin"
	---help---
	  Path to the firmware file.

config BCM4329_NVRAM_PATH
	depends on BCM4329
	string "NVRAM path"
	default "/etc/wl/nvram.txt"
	---help---
	  Path to the nvram file.

config BCM4329_IFACE_NAME
	depends on BCM4329
	string "Wireless network interface name"
	default "wlan"

config BCM4329_DEBUG
	depends on BCM4329
	bool "Debug"
	default n

config BCM4329_SOFTAP
	depends on BCM4329
	bool "Support SoftAP function"
	default y
```
